# file: Multi_Interrupt_Via_Button.ioc
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Mcu.Family=STM32F4
Mcu.Name=STM32F429ZITx
Mcu.Package=LQFP144
NVIC.PriorityGroup=NVIC_PRIORITYGROUP_4
PA13.Mode=Serial_Wire
PA13.Signal=SYS_JTMS-SWDIO
PA14.Mode=Serial_Wire
PA14.Signal=SYS_JTCK-SWCLK
PH0/OSC_IN.Mode=HSE-External-Oscillator
PH0/OSC_IN.Signal=RCC_OSC_IN
PH1/OSC_OUT.Mode=HSE-External-Oscillator
PH1/OSC_OUT.Signal=RCC_OSC_OUT
ProjectManager.HeapSize=0x200
ProjectManager.StackSize=0x400
ProjectManager.TargetToolchain=STM32CubeIDE
RCC.48MHZClocksFreq_Value=90000000
RCC.AHBFreq_Value=180000000
RCC.APB1CLKDivider=RCC_HCLK_DIV4
RCC.APB1Freq_Value=45000000
RCC.APB1TimFreq_Value=90000000
RCC.APB2CLKDivider=RCC_HCLK_DIV2
RCC.APB2Freq_Value=90000000
RCC.APB2TimFreq_Value=180000000
RCC.CortexFreq_Value=180000000
RCC.HCLKFreq_Value=180000000
RCC.HSE_VALUE=8000000
RCC.HSI_VALUE=16000000
RCC.LSE_VALUE=32768
RCC.PLLM=4
RCC.PLLN=180
RCC.PLLSourceVirtual=RCC_PLLSOURCE_HSE
RCC.SYSCLKFreq_VALUE=180000000
RCC.SYSCLKSource=RCC_SYSCLKSOURCE_PLLCLK
RCC.VCOOutputFreq_Value=360000000
board=custom

// file: Core/Src/main.c
/* USER CODE BEGIN Header */
/**
  ******************************************************************************
  * @file           : main.c
  * @brief          : Main program body
  ******************************************************************************
  * @attention
  *
  * Copyright (c) 2022 STMicroelectronics.
  * All rights reserved.
  *
  * This software is licensed under terms that can be found in the LICENSE file
  * in the root directory of this software component.
  * If no LICENSE file comes with this software, it is provided AS-IS.
  *
  ******************************************************************************
  */
/* USER CODE END Header */
#include "main.h"

/* USER CODE BEGIN PV */

volatile int flg;
volatile int portPC13counter;
volatile int portPG1counter;

/* USER CODE END PV */

void SystemClock_Config(void);
static void MX_GPIO_Init(void);

int main(void)
{

  /* MCU Configuration--------------------------------------------------------*/

  /* Reset of all peripherals, Initializes the Flash interface and the Systick. */
  HAL_Init();

  /* Configure the system clock */
  SystemClock_Config();

  /* Initialize all configured peripherals */
  MX_GPIO_Init();
  /* USER CODE BEGIN 2 */

  //************************	Interrupt	***************************//
   	  __disable_irq();

   // setup LEDs
     RCC->AHB1ENR |= (1<<1);		// FOR PORT B
     RCC->AHB1ENR |= (1<<2);		// FOR PORT C
     RCC->AHB1ENR |= (1<<6);		// FOR PORT G
     					      /*****	   LED	  *****/
  	  GPIOB->MODER |= (1<<0);		//	General purpose output mode PIN 0
  	  GPIOB->MODER |= (1<<14);		//	General purpose output mode PIN 7
  	  GPIOB->MODER |= (1<<28);		//	General purpose output mode PIN 14
  	  	  	  	  	      /*****	  BUTTONS		*****/
  	  GPIOC->MODER |= (1<<26);		//	General purpose output mode PIN 13 ((USER BUTTON))
  					     /*******	 FOR PG1	*******/
  	 	  GPIOG->MODER |= (1<<1);		//	General purpose output mode PIN 1   ((EXT BUTTON))
  	 	  GPIOG->PUPDR	&=	~(GPIO_PUPDR_PUPDR1);

  	  	  	  	  	  	  	  	      /*****	 INTERRUPT		*****/
  	  RCC->APB2ENR |= RCC_APB2ENR_SYSCFGEN;

  	  	  	  	  	  	  	  /*****	 INTERRUPT FOR PC13	BUTTON		*****/
  	  SYSCFG->EXTICR[3] |= 0x0020;

  	  EXTI->IMR |= 0x2000;		//Interrupt mask register
  	  EXTI->FTSR |=	0x2000;		//Falling trigger selection register

  	  //////////////////////////  2nd button ///////////////////////

  	  	 SYSCFG->EXTICR[0] &= ~(0xF << 4);
  	  	 	  	  	  	  	  	  	  	  	  /*******	 FOR PG1	*******/
  	  	 	  SYSCFG->EXTICR[0] |= (0<<7);		//external interrupt configuration register
  	  	 	  SYSCFG->EXTICR[0] |= (1<<6);
  	  	 	  SYSCFG->EXTICR[0] |= (1<<5);
  	  	 	  SYSCFG->EXTICR[0] |= (0<<4);

  	  	 	  EXTI->IMR |= (1<<1);		//Interrupt mask register
  	  	 	  EXTI->FTSR |=	(1<<1);		//Falling trigger selection register

  	  	 	  NVIC_EnableIRQ(EXTI1_IRQn);	//Interrupt Handler
  	  	  	  NVIC_SetPriority(EXTI1_IRQn, 0);

  	  /////////////////////////// 2nd button end ///////////////////////////

  	  NVIC_EnableIRQ(EXTI15_10_IRQn);	//Interrupt Handler
  	  NVIC_SetPriority(EXTI15_10_IRQn, 1);

  	  __enable_irq();

      	 //**********************************************************//

  /* USER CODE END 2 */

  /* Infinite loop */
  while (1)
  {

    /* USER CODE BEGIN 3 */
	  GPIOB->ODR ^= (1<<0);
 	  HAL_Delay(200);
  }
  /* USER CODE END 3 */
}

void SystemClock_Config(void)
{
  RCC_OscInitTypeDef RCC_OscInitStruct = {0};
  RCC_ClkInitTypeDef RCC_ClkInitStruct = {0};

  /** Configure the main internal regulator output voltage
  */
  __HAL_RCC_PWR_CLK_ENABLE();
  __HAL_PWR_VOLTAGESCALING_CONFIG(PWR_REGULATOR_VOLTAGE_SCALE1);

  /** Initializes the RCC Oscillators according to the specified parameters
  * in the RCC_OscInitTypeDef structure.
  */
  RCC_OscInitStruct.OscillatorType = RCC_OSCILLATORTYPE_HSE;
  RCC_OscInitStruct.HSEState = RCC_HSE_ON;
  RCC_OscInitStruct.PLL.PLLState = RCC_PLL_ON;
  RCC_OscInitStruct.PLL.PLLSource = RCC_PLLSOURCE_HSE;
  RCC_OscInitStruct.PLL.PLLM = 4;
  RCC_OscInitStruct.PLL.PLLN = 180;
  RCC_OscInitStruct.PLL.PLLP = RCC_PLLP_DIV2;
  RCC_OscInitStruct.PLL.PLLQ = 4;
  if (HAL_RCC_OscConfig(&RCC_OscInitStruct) != HAL_OK)
  {
    Error_Handler();
  }

  /** Activate the Over-Drive mode
  */
  if (HAL_PWREx_EnableOverDrive() != HAL_OK)
  {
    Error_Handler();
  }

  /** Initializes the CPU, AHB and APB buses clocks
  */
  RCC_ClkInitStruct.ClockType = RCC_CLOCKTYPE_HCLK|RCC_CLOCKTYPE_SYSCLK
                              |RCC_CLOCKTYPE_PCLK1|RCC_CLOCKTYPE_PCLK2;
  RCC_ClkInitStruct.SYSCLKSource = RCC_SYSCLKSOURCE_PLLCLK;
  RCC_ClkInitStruct.AHBCLKDivider = RCC_SYSCLK_DIV1;
  RCC_ClkInitStruct.APB1CLKDivider = RCC_HCLK_DIV4;
  RCC_ClkInitStruct.APB2CLKDivider = RCC_HCLK_DIV2;

  if (HAL_RCC_ClockConfig(&RCC_ClkInitStruct, FLASH_LATENCY_5) != HAL_OK)
  {
    Error_Handler();
  }
}

static void MX_GPIO_Init(void)
{

  /* GPIO Ports Clock Enable */
  __HAL_RCC_GPIOH_CLK_ENABLE();
  __HAL_RCC_GPIOA_CLK_ENABLE();

}

/* USER CODE BEGIN 4 */

/*************************************************
* interrupt handler	PG1 EXT BUTTON
*************************************************/

void EXTI15_10_IRQHandler(void)
{
						/*		PC13 EXT USER BUTTON COUNTER		*/
if(EXTI->PR == 0x2000)
{
//	GPIOB->ODR ^= (1<<0);
	GPIOB->ODR |= (1<<14);
	portPC13counter++;
	EXTI->PR |=	0x2000;		//PC13
}

}

void EXTI1_IRQHandler(void)
{

	/*if(flg == 0) //on
		{
			if(GPIOG->IDR == 0xf7bc)
				{
					GPIOB->ODR	|=	(1<<7);
				}
			flg = 1;
		}

		else if(flg == 1)
		{
			if(GPIOG->IDR == 0xf7bc)
				{
					GPIOB->ODR &= ~(1<<7);
				}

			flg = 0;
		}*/

	GPIOB->ODR &= ~(1<<14);

	EXTI->PR |=	EXTI_PR_PR1;	//This bit is set when the selected edge event arrives on the external interrupt line.
}

/* USER CODE END 4 */

void Error_Handler(void)
{
  __disable_irq();
  while (1)
  {
  }
}
